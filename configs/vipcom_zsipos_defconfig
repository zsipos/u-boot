## configs/vipcom_zsipos_defconfig
```kconfig
CONFIG_RISCV=y
CONFIG_BOOTCOMMAND="zsiposboot"
CONFIG_DEFAULT_DEVICE_TREE="zsipos"
CONFIG_NR_DRAM_BANKS=1
CONFIG_ENV_SIZE=0x20000
CONFIG_TARGET_VIPCOM_ZSIPOS=y
CONFIG_ARCH_RV64I=y
CONFIG_DISTRO_DEFAULTS=y
CONFIG_FIT=n
CONFIG_DISPLAY_CPUINFO=y
CONFIG_DISPLAY_BOARDINFO=y
CONFIG_OF_EMBED=y
CONFIG_SYS_RELOC_GD_ENV_ADDR=y
CONFIG_NET=n
CONFIG_EFI=n
CONFIG_CMD_BOOTEFI=n
CONFIG_EFILOADER=n

CONFIG_SF_DEFAULT_BUS=2
CONFIG_SF_DEFAULT_CS=0

#CONFIG_CMD_CONFIG=y
#CONFIG_LOG=y
#CONFIG_LOG_CONSOLE=y
#CONFIG_LOG_FUNC=y
#CONFIG_LOG_MAX_LEVEL=7
#CONFIG_DM_DEBUG=y
```
